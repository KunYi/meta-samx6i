## conf/layer.conf
```bitbake
# We have a conf and classes directory, add to BBPATH
BBPATH .= ":${LAYERDIR}"

# We have recipes-* directories, add to BBFILES
BBFILES += "${LAYERDIR}/recipes-*/*/*.bb \
	    ${LAYERDIR}/recipes-*/*/*.bbappend "

BBFILE_COLLECTIONS += "samx6i"
BBFILE_PATTERN_samx6i = "^${LAYERDIR}/"
BBFILE_PRIORITY_samx6i = "16"
```

## conf/machine/include/imx-common.inc
```bitbake
# Provides the i.MX6 common settings

require conf/machine/include/imx-base.inc
require conf/machine/include/tune-cortexa9.inc

SERIAL_CONSOLES = "115200;ttymxc0"
UBOOT_ENTRYPOINT_mx6  = "0x12000000"

MACHINE_FEATURES += "pci "
```

## conf/machine/samx6i.conf
```bitbake
#@TYPE: Machine
#@NAME: Kontron sAMX6i/i.MX6Q with 1GB
#@SOC: i.MX6Q
#@DESCRIPTION: Machine configuration for Kontron sAMX6i/i.MX6Q with 1GB SKU
#@MAINTAINER: KunYi Chen <kunyi.chen@gmail.com>

require conf/machine/include/imx-common.inc

SOC_FAMILY = "mx6:mx6q"

KERNEL_DEVICETREE = "smx6q.dtb"

UBOOT_CONFIG ??= "spi"
UBOOT_CONFIG[spi] = "samx6i_defconfig"

DISTRO_FEATURES_append = " systemd"
VIRTUAL-RUNTIME_init_manager = "systemd"
IMAGE_INSTALL_append += " systemd-serialgetty"

USE_DEVFS = "1"
```
